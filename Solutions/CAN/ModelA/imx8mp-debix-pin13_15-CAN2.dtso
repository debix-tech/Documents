/dts-v1/;
/plugin/;

#include "imx8mp-pinfunc.h"


&flexcan2 {
	pinctrl-names = "default";
	pinctrl-0 = <&pinctrl_flexcan2>;
	//xceiver-supply = <&reg_can2_stby>;
	//pinctrl-assert-gpios = <&pca6416 3 GPIO_ACTIVE_HIGH>;
	status = "okay";/* can2 pin conflict with pdm */
};

&iomuxc {
	pinctrl_flexcan2: flexcan2grp {
		fsl,pins = <
			MX8MP_IOMUXC_UART3_RXD__CAN2_TX         0x154
			MX8MP_IOMUXC_UART3_TXD__CAN2_RX         0x154
		>;
	};
};
