/dts-v1/;
/plugin/;

#include "imx8mp-pinfunc.h"

&pwm4 {
	pinctrl-names = "default";
	pinctrl-0 = <&pinctrl_pwm4>;
	status = "okay";
};

&iomuxc {
	pinctrl_pwm4: pwm4grp {
		fsl,pins = <
			MX8MP_IOMUXC_SAI5_RXFS__PWM4_OUT		0x116
		>;
	};
};

