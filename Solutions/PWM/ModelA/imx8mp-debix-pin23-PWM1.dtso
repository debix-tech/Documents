/dts-v1/;
/plugin/;

#include "imx8mp-pinfunc.h"

&pwm1 {
	pinctrl-names = "default";
	pinctrl-0 = <&pinctrl_pwm1>;
	status = "okay";
};

&iomuxc {
	pinctrl_pwm1: pwm1grp {
		fsl,pins = <
			MX8MP_IOMUXC_I2C4_SDA__PWM1_OUT		0x116
		>;
	};
};

