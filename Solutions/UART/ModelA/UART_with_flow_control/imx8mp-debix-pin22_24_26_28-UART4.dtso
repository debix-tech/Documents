/dts-v1/;
/plugin/;

#include "imx8mp-pinfunc.h"

&uart4 {
	pinctrl-names = "default";
	pinctrl-0 = <&pinctrl_uart4>;	
	status = "okay";
};

&iomuxc {
	pinctrl_uart4: uart4grp {
		fsl,pins = <
			MX8MP_IOMUXC_ECSPI2_MOSI__UART4_DCE_TX		0x140
			MX8MP_IOMUXC_ECSPI2_SCLK__UART4_DCE_RX		0x140
			MX8MP_IOMUXC_ECSPI2_SS0__UART4_DCE_RTS		0x140
			MX8MP_IOMUXC_ECSPI2_MISO__UART4_DCE_CTS		0x140
		>;
	};
};

