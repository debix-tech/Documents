/dts-v1/;
/plugin/;

#include "imx8mp-pinfunc.h"


&uart2{
	pinctrl-names = "default";
	pinctrl-0 = <&pinctrl_uart2>;
	status = "okay";
};

&iomuxc {
	pinctrl_uart2: uart2grp {
		fsl,pins = <
			MX8MP_IOMUXC_UART2_RXD__UART2_DCE_RX	0x14f
			MX8MP_IOMUXC_UART2_TXD__UART2_DCE_TX	0x14f
		>;
	};
};

