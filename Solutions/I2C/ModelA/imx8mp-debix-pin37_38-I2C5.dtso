/dts-v1/;
/plugin/;

#include "imx8mp-pinfunc.h"


&i2c5 {
	clock-frequency = <400000>;
	pinctrl-names = "default";
	pinctrl-0 = <&pinctrl_i2c5>;
	status = "okay";
};

&iomuxc {
	pinctrl_i2c5: i2c5grp {
		fsl,pins = <
			MX8MP_IOMUXC_SAI5_RXD0__I2C5_SCL		0x400001c3
			MX8MP_IOMUXC_SAI5_MCLK__I2C5_SDA		0x400001c3
		>;
	};
};

